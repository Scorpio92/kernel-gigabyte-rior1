## drivers/misc/mmc3280ma/Kconfig
```kconfig
#
# Magnetometer Configuration
#

config MAG
	bool "Magnetic Sensor"
	default y
	help
	This option enables Magnetomter

config SENSORS_MMC314x_MAG
	tristate "MMC3140 magnetic sensor support"
	depends on I2C
	help
	  If you say yes here you get support for MEMSIC's
	  magnetic sensors MMC314x.

config SENSORS_MMC328x_MAG
	tristate "MMC328x magnetic sensor support"
	depends on I2C
	help
	  If you say yes here you get support for MEMSIC's
	  magnetic sensors MMC328xMS.

config SENSORS_MMC328xMA_MAG
	tristate "MMC328xMA magnetic sensor support"
	depends on I2C
	help
	  If you say yes here you get support for MEMSIC's
	  magnetic sensors MMC328xMA.
```
